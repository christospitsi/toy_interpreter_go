n = 8
k = 1
f = 1
while (k <= n) {
    f = f * k
    k = k + 1
}

print f
