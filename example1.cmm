m = 7
n = 25
p = m - 3 + n / 2 * (0 - 5 + m * n % 4)
print p
