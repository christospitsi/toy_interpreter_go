m = 7
n = 25
p = m - 3 + n / 2 * (0 - 5 + m * n % 4)

b = m < n && n <= p

if (b) {
    x = 1
} else {
    x = 0
}

print x
