val = 1

while (val < 100) {
    val = 2 * val
}

print val
