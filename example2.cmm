m = 7
n = 25
p = m - 3 + n / 2 * (0 - 5 + m * n % 4)

a = m > n || n >= p

if (a)
    print 1
  else
    print 0
